## ESP32/cat_watch_esp32s3/firmware/main/Kconfig.projbuild
```kconfig
menu "Cat Watch Configuration"

config CATWATCH_WIFI_SSID
    string "Wi-Fi SSID"
    default ""
    help
        Wi-Fi SSID used by the ESP32-S3 station.

config CATWATCH_WIFI_PASSWORD
    string "Wi-Fi password"
    default ""
    help
        Wi-Fi password used by the ESP32-S3 station.

config CATWATCH_CAMERA_FRAME_WIDTH
    int "Camera logical frame width"
    default 320

config CATWATCH_CAMERA_FRAME_HEIGHT
    int "Camera logical frame height"
    default 240

config CATWATCH_DETECTOR_STUB
    bool "Use stub detector"
    default y
    help
        Keep this enabled until ESP-Detection cat model integration is added.

endmenu
```

## ESP32/cat_watch_esp32s3/firmware/sdkconfig.defaults
```kconfig
CONFIG_ESP32S3_SPIRAM_SUPPORT=y
CONFIG_SPIRAM=y
CONFIG_SPIRAM_MODE_OCT=y
CONFIG_SPIRAM_SPEED_80M=y
CONFIG_SPIRAM_USE_MALLOC=y
CONFIG_ESP_MAIN_TASK_STACK_SIZE=8192
CONFIG_HTTPD_MAX_REQ_HDR_LEN=1024
CONFIG_HTTPD_MAX_URI_LEN=512
```
